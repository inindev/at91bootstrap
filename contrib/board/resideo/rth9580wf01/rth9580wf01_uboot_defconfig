## contrib/board/resideo/rth9580wf01/rth9580wf01_uboot_defconfig
```kconfig
CONFIG_RTH9580WF01=y
CONFIG_SPI_CLK=50000000
CONFIG_IMG_ADDRESS="0x00010000"
CONFIG_JUMP_ADDR="0x20f50000"
CONFIG_IMG_SIZE="0x000b0000"
CONFIG_DEBUG=y
```
